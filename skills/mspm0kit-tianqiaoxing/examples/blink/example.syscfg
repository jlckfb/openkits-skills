// == Generated by scaffold.py ==
// Minimal LED blink example for Tianqiaoxing G3519
// GPIO instance $name="GPIO_LED", pin $name="PIN"
//   -> Macros: GPIO_LED_PORT, GPIO_LED_PIN_PIN
/**
 * They will be automatically applied on subsequent loads
 * @cliArgs --device "MSPM0G3519" --package "LQFP-64(PM)"
 * @versions {"tool":"1.24.0+4110"}
 */

const GPIO   = scripting.addModule("/ti/driverlib/GPIO", {}, false);
const GPIO1  = GPIO.addInstance();
const SYSCTL = scripting.addModule("/ti/driverlib/SYSCTL");

SYSCTL.forceDefaultClkConfig = true;
SYSCTL.clockTreeEn           = true;

/* PB22 onboard LED (active-low) */
GPIO1.$name                          = "GPIO_LED";
GPIO1.associatedPins[0].$name        = "PIN";
GPIO1.associatedPins[0].direction    = "OUTPUT";
GPIO1.associatedPins[0].initialValue = "SET";
GPIO1.associatedPins[0].assignedPort = "PORTB";
GPIO1.associatedPins[0].assignedPin  = "22";
GPIO1.associatedPins[0].pin.$assign  = "PB22";
